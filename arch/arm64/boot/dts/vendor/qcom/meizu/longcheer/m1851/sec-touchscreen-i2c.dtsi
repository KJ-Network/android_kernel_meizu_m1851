/*
 * This program is free software; you can redistribute it and/or modify
 * it under the terms of the GNU General Public License as published by
 * the Free Software Foundation; either version 2 of the License, or
 * (at your option) any later version.
 *
 * This program is distributed in the hope that it will be useful, but WITHOUT
 * ANY WARRANTY; without even the implied warranty of MERCHANTABILITY or
 * FITNESS FOR A PARTICULAR PURPOSE.  See the GNU General Public License for
 * more details.
 *
 */

&i2c_4 {
	status = "okay";

	sec_ts: sec_touchscreen@48 {
		compatible = "sec,sec_ts";
		reg = <0x48>;
		status = "okay";

		sec,irq_gpio = <&tlmm 67 0x2008>;

		pinctrl-names = "on_state", "off_state";
		pinctrl-0 = <&ts_active>;
		pinctrl-1 = <&ts_int_suspend>;

		sec,max_coords = <1080 2160>;
		sec,num_lines = <18 32>;
	};
};
