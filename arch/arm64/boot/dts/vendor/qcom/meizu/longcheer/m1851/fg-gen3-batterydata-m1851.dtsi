
qcom,itech_3000mah {
	qcom,max-voltage-uv = <0x432380>;
	qcom,fg-cc-cv-threshold-mv = <0x1126>;
	qcom,fastchg-current-ma = <0x9c4>;
	qcom,batt-id-kohm = <0x44>;
	qcom,battery-beta = <0xd6b>;
	qcom,battery-type = "sunmoda_3300mah_jan10th2017";
	qcom,checksum = <0xfb8f>;
	qcom,gui-version = "PMI8998GUI - 2.0.0.54";
	qcom,fg-profile-data = <0xa41f6e05 0x9c0a2bfc 0x321d23e5 0x600b1b15 0xad178c22 0xea3c894a 0x5b000000 0x12000000 0x62c2 0xccdd8c2 0x19000800 0x85eac7ec 0xe2052f01 0x9bf51212 0x5e05883b 0x22060920 0x27001400 0x7d1fdd05 0x3f0ae5fc 0x721de3f5 0x6f12c01d 0x8818fb22 0x8d45c652 0x54000000 0xf000000 0xbdcd 0x55c25dc5 0x14000000 0x7e00c7ec 0x6006bb00 0x59066103 0xd9fc751b 0xb333ccff 0x7100000 0x3e0b9945 0x14004000 0xae010afa 0xff000000 0x00 0x00 0x00 0x00 0x00 0x00 0x00 0x00 0x00 0x00 0x00 0x00 0x00 0x00 0x00 0x00 0x00 0x00>;
};

qcom,ascent_3450mah {
	qcom,max-voltage-uv = <0x432380>;
	qcom,fg-cc-cv-threshold-mv = <0x1126>;
	qcom,fastchg-current-ma = <0x9c4>;
	qcom,batt-id-kohm = <0x01>;
	qcom,battery-beta = <0xd6b>;
	qcom,battery-type = "drn_3300mah_averaged_masterslave_jan6th2017";
	qcom,checksum = <0x96ac>;
	qcom,gui-version = "PMI8998GUI - 2.0.0.54";
	qcom,fg-profile-data = <0x9c1f8505 0x820a73fc 0x2b1d72ea 0xee03660c 0xc817f422 0xe0451f52 0x5c000000 0x10000000 0x4ac4 0xc7bc48c2 0xf000800 0xe1da5ded 0x8dfdb2f3 0x96e2a712 0x7ef40e3b 0x24060920 0x27001400 0x831fee05 0x1f0a45fd 0x6b1d53e5 0xec0b3114 0x44184923 0x1845a653 0x55000000 0xe000000 0x61cc 0xb7c30fbc 0xf000000 0x92005ded 0xe306e000 0x75fd9c03 0x47dbb322 0xcb33ccff 0x7100000 0x990d9945 0xf004000 0xab010afa 0xff000000 0x00 0x00 0x00 0x00 0x00 0x00 0x00 0x00 0x00 0x00 0x00 0x00 0x00 0x00 0x00 0x00 0x00 0x00>;
};

qcom,drn_gy_3300mah {
	qcom,max-voltage-uv = <0x432380>;
	qcom,fg-cc-cv-threshold-mv = <0x1126>;
	qcom,fastchg-current-ma = <0x9c4>;
	qcom,batt-id-kohm = <0x96>;
	qcom,battery-beta = <0xd6b>;
	qcom,battery-type = "drn_gy_3300mah_jan10th2017";
	qcom,checksum = <0xfb8f>;
	qcom,gui-version = "PMI8998GUI - 2.0.0.54";
	qcom,fg-profile-data = <0xa41f6e05 0x9c0a2bfc 0x321d23e5 0x600b1b15 0xad178c22 0xea3c894a 0x5b000000 0x12000000 0x62c2 0xccdd8c2 0x19000800 0x85eac7ec 0xe2052f01 0x9bf51212 0x5e05883b 0x22060920 0x27001400 0x7d1fdd05 0x3f0ae5fc 0x721de3f5 0x6f12c01d 0x8818fb22 0x8d45c652 0x54000000 0xf000000 0xbdcd 0x55c25dc5 0x14000000 0x7e00c7ec 0x6006bb00 0x59066103 0xd9fc751b 0xb333ccff 0x7100000 0x3e0b9945 0x14004000 0xae010afa 0xff000000 0x00 0x00 0x00 0x00 0x00 0x00 0x00 0x00 0x00 0x00 0x00 0x00 0x00 0x00 0x00 0x00 0x00 0x00>;
};
