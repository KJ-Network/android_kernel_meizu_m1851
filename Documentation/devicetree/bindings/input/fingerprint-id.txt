## Documentation/devicetree/bindings/input/fingerprint-id.txt
```
Fingerprint sensor ID selector

The selector supplies power to the fingerprint sensor and samples an ID GPIO
to select the sensor driver used on boards populated with one of two sensors.

Required properties:
- compatible: must be "wind,fp_id"
- finger,gpio_id: GPIO specifier for the sensor ID input
- vdd_fp-supply: phandle to the fingerprint sensor power regulator

Example:

	fp_id {
		compatible = "wind,fp_id";
		finger,gpio_id = <&tlmm 21 0>;
		vdd_fp-supply = <&pmic_l6>;
	};
```

## drivers/input/fingerprint/Kconfig
```kconfig
config INPUT_FINGERPRINT
	tristate "Fingerprint driver support"
	help
	  Say Y here to enable fingerprint driver support.

if INPUT_FINGERPRINT
    menu "Fingerprint sensors"
config FINGERPRINT_ID
	bool "Fingerprint sensor selector"
	depends on OF && GPIOLIB
	help
	  Selects the Goodix or ET512 sensor using the board fingerprint ID
	  GPIO and keeps the shared selector GPIO owned by one driver.

        source "drivers/input/fingerprint/goodix/Kconfig"
        source "drivers/input/fingerprint/et512/Kconfig"
    endmenu
endif
```

## drivers/input/fingerprint/et512/Kconfig
```kconfig
config FINGERPRINT_ET512
	tristate "Egis ET512 fingerprint sensor"
	depends on OF && GPIOLIB
	select FINGERPRINT_ID
	help
	  Say Y here to enable support for the Egis ET512 fingerprint
	  sensor. The driver provides the esfp0 character device and the
	  navigation input interface used by the fingerprint service. It
	  also handles sensor reset and interrupt notification through the
	  platform GPIOs described by the device tree.
```

## drivers/input/fingerprint/goodix/Kconfig
```kconfig
config FINGERPRINT_GOODIX
	tristate "Goodix fingerprint support"
	select FINGERPRINT_ID
	help
	  Say Y here to enable the Goodix TEE fingerprint sensor driver.
	  The driver exposes the character device, input events, display state
	  notifications and the netlink interface used by the fingerprint HAL.
```
